## arch/m68k/configs/rosco_m68k_defconfig
```kconfig
CONFIG_LOCALVERSION="-rosco"
CONFIG_LOCALVERSION_AUTO=y
CONFIG_CC_OPTIMIZE_FOR_SIZE=y
CONFIG_EXPERT=y
# CONFIG_MULTIUSER is not set
# CONFIG_FHANDLE is not set
# CONFIG_POSIX_TIMERS is not set
CONFIG_PRINTK=y
CONFIG_CONSOLE_LOGLEVEL_DEFAULT=6
CONFIG_LOG_BUF_SHIFT=10
CONFIG_CMDLINE_LOG_WRAP_IDEAL_LEN=160
# CONFIG_BUG is not set
# CONFIG_ELF_CORE is not set
# CONFIG_COREDUMP is not set
# CONFIG_BASE_FULL is not set
CONFIG_BASE_SMALL=y
# CONFIG_FUTEX is not set
# CONFIG_EPOLL is not set
# CONFIG_SIGNALFD is not set
# CONFIG_TIMERFD is not set
# CONFIG_EVENTFD is not set
# CONFIG_AIO is not set
# CONFIG_IO_URING is not set
# CONFIG_ADVISE_SYSCALLS is not set
CONFIG_EMBEDDED=y
# CONFIG_MMU is not set
CONFIG_M68KCLASSIC=y
CONFIG_ROSCO_M68K=y
CONFIG_ROSCO_M68K_ROMFS_POC=y
CONFIG_RAMBASE=0x0
CONFIG_RAMSIZE=0x100000
CONFIG_VECTORBASE=0x0
CONFIG_KERNELBASE=0x1000
CONFIG_4KSTACKS=y
CONFIG_RAMKERNEL=y
CONFIG_BLOCK=y
CONFIG_PARTITION_ADVANCED=y
# CONFIG_MSDOS_PARTITION is not set
# CONFIG_EFI_PARTITION is not set
# CONFIG_BINFMT_ELF_FDPIC is not set
# CONFIG_BINFMT_SCRIPT is not set
CONFIG_BINFMT_FLAT=y
# CONFIG_INPUT is not set
CONFIG_TTY=y
# CONFIG_VT is not set
# CONFIG_LEGACY_PTYS is not set
# CONFIG_UNIX98_PTYS is not set
CONFIG_SERIAL_SCCNXP=y
CONFIG_SERIAL_SCCNXP_CONSOLE=y
CONFIG_SPI=y
CONFIG_SPI_BITBANG=y
CONFIG_MMC=y
CONFIG_MMC_BLOCK=y
CONFIG_MMC_BLOCK_MINORS=4
CONFIG_MMC_SPI=y
CONFIG_MISC_FILESYSTEMS=y
CONFIG_ROMFS_FS=y
CONFIG_ROMFS_BACKED_BY_BLOCK=y
# CONFIG_DEVMEM is not set
# CONFIG_HWMON is not set
# CONFIG_HID_SUPPORT is not set
# CONFIG_USB_SUPPORT is not set
# CONFIG_FW_LOADER is not set
# CONFIG_FILE_LOCKING is not set
# CONFIG_DNOTIFY is not set
# CONFIG_INOTIFY_USER is not set
# CONFIG_FANOTIFY is not set
# CONFIG_SYSFS is not set
# CONFIG_PROC_FS is not set
# CONFIG_VM_EVENT_COUNTERS is not set
# CONFIG_KALLSYMS is not set
CONFIG_INIT_STACK_NONE=y
CONFIG_SLUB_TINY=y
# CONFIG_SLUB_DEBUG is not set
CONFIG_LD_DEAD_CODE_DATA_ELIMINATION=y
CONFIG_BOOTPARAM=y
CONFIG_BOOTPARAM_STRING="console=ttySC0,115200 loglevel=6 panic=0 dhash_entries=128 ihash_entries=128 mhash_entries=64 mphash_entries=64 root=/dev/mmcblk0 rootfstype=romfs ro rootwait init=/init"
# CONFIG_RANDOM_TRUST_CPU is not set
# CONFIG_RANDOM_TRUST_BOOTLOADER is not set
```
